## Documentation/devicetree/bindings/soc/actions/owl-socinfo.yaml
```yaml
# SPDX-License-Identifier: (GPL-2.0-only OR BSD-2-Clause)
%YAML 1.2
---
$id: http://devicetree.org/schemas/soc/actions/owl-socinfo.yaml#
$schema: http://devicetree.org/meta-schemas/core.yaml#

title: Actions Semi Owl SoC info module

maintainers:
  - Cristian Ciocaltea <cristian.ciocaltea@gmail.com>

description: |
  Actions Semi Owl SoC info module provides access to various information
  about the S500, S700 and S900 SoC variants, such as serial number or id.

patternProperties:
  "^soc(@[0-9a-f]+)?$":
    type: object
    properties:
      compatible:
        items:
          - enum:
              - actions,s500-soc
              - actions,s700-soc
              - actions,s900-soc
          - const: simple-bus

      "#address-cells":
        enum: [1, 2]

      "#size-cells":
        enum: [1, 2]

      ranges: true

      actions,serial-number-addrs:
        description: |
          Contains the physical addresses in DDR memory where the two parts
          of the serial number (low & high) can be read from.
          This is currently supported only on the S500 SoC variant.
        $ref: /schemas/types.yaml#/definitions/uint32-array
        minItems: 2
        maxItems: 2

    required:
      - compatible

    additionalProperties:
      type: object

additionalProperties: true

examples:
  - |
    / {
        compatible = "roseapplepi,roseapplepi", "actions,s500";
        model = "Roseapple Pi";
        #address-cells = <1>;
        #size-cells = <1>;

        soc {
            compatible = "actions,s500-soc", "simple-bus";
            #address-cells = <1>;
            #size-cells = <1>;
            ranges;
            actions,serial-number-addrs = <0x800>, /* S/N Low */
                                          <0x804>; /* S/N High */
        };
    };

...
```
